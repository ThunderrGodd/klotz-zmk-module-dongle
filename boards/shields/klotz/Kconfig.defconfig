## boards/shields/klotz/Kconfig.defconfig
```kconfig
if SHIELD_KLOTZ_DONGLE

    config ZMK_KEYBOARD_NAME
        default "KLOTZ"

    config ZMK_SPLIT_BLE_ROLE_CENTRAL
        default y

    config ZMK_USB
        default y

    config ZMK_SPLIT_BLE_CENTRAL_PERIPHERALS
        default 2

    config BT_MAX_CONN
        default 5

    config BT_MAX_PAIRED
        default 5

endif # DONGLE



if SHIELD_KLOTZ_DONGLE || SHIELD_KLOTZ_LEFT || SHIELD_KLOTZ_RIGHT

    config ZMK_SPLIT
        default y

    config ZMK_BLE
        default y

endif # DONGLE LEFT RIGHT



if ZMK_BACKLIGHT

    config PWM
        default y

    config LED_PWM
        default y

endif # ZMK_BACKLIGHT
```
